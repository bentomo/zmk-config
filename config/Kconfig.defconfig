## config/Kconfig.defconfig
```kconfig
if SHIELD_KIAI_RIGHT

config ZMK_KEYBOARD_NAME
	default "TOMO"

config ZMK_SPLIT_BLE_ROLE_CENTRAL
	default y

endif

if SHIELD_TOMO_RIGHT || SHIELD_TOMO_LEFT 

config ZMK_SPLIT
	default y

endif
```

## config/boards/shields/tomo/Kconfig.shield
```kconfig
config SHIELD_TOMO_LEFT
	def_bool $(shields_list_contains,tomo_left)

config SHIELD_TOMO_RIGHT
	def_bool $(shields_list_contains,tomo_right)
```
